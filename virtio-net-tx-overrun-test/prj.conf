## CMakeLists.txt
```
# SPDX-License-Identifier: Apache-2.0
cmake_minimum_required(VERSION 3.28.0)
find_package(Zephyr REQUIRED HINTS $ENV{ZEPHYR_BASE})
project(virtio_net_tx_overrun)

target_sources(app PRIVATE src/main.c)
```

## prj.conf
```kconfig
# SPDX-License-Identifier: Apache-2.0
CONFIG_NETWORKING=y
CONFIG_NET_L2_ETHERNET=y
CONFIG_ETH_VIRTIO_NET=y
CONFIG_NET_PKT_TX_COUNT=8
CONFIG_NET_PKT_RX_COUNT=8
CONFIG_NET_BUF_TX_COUNT=32
CONFIG_NET_BUF_RX_COUNT=16
CONFIG_MAIN_STACK_SIZE=4096
```

## src/main.c
```c
/*
 * virtio-net TX length test: sends frames of several sizes through the
 * driver and checks that frames larger than the TX buffer are rejected.
 *
 * SPDX-License-Identifier: Apache-2.0
 */
#include <errno.h>
#include <zephyr/kernel.h>
#include <zephyr/net/net_if.h>
#include <zephyr/net/net_l2.h>
#include <zephyr/net/net_pkt.h>
#include <zephyr/net/ethernet.h>

static int send_frame(const struct device *dev, size_t len)
{
	const struct ethernet_api *api = (const struct ethernet_api *)dev->api;
	struct net_pkt *pkt;
	int ret;

	/*
	 * Allocate without an iface: net_pkt_alloc_with_buffer() caps a packet
	 * on an Ethernet iface at NET_ETH_MAX_FRAME_SIZE, which would prevent
	 * the oversized frames this test feeds to the driver.
	 */
	pkt = net_pkt_alloc_with_buffer(NULL, len, NET_AF_UNSPEC, 0, K_FOREVER);
	if (pkt == NULL) {
		printk("SEND len=%u alloc failed\n", (unsigned int)len);
		return -ENOMEM;
	}

	ret = net_pkt_memset(pkt, 0xa5, len);
	if (ret != 0) {
		printk("SEND len=%u fill failed ret=%d\n", (unsigned int)len, ret);
		net_pkt_unref(pkt);
		return -EIO;
	}

	net_pkt_cursor_init(pkt);
	ret = api->send(dev, pkt);
	printk("SEND len=%u ret=%d\n", (unsigned int)len, ret);
	net_pkt_unref(pkt);

	return ret;
}

int main(void)
{
	struct net_if *iface;
	const struct device *dev;
	bool pass = true;

	printk("TX_OVERRUN start\n");

	iface = net_if_get_first_by_type(&NET_L2_GET_NAME(ETHERNET));
	if (iface == NULL) {
		printk("TX_OVERRUN no ethernet interface\n");
		printk("RESULT FAIL\n");
		return 1;
	}

	dev = net_if_get_device(iface);
	printk("TX_OVERRUN dev=%s ready=%d\n", dev->name, device_is_ready(dev));
	if (!device_is_ready(dev)) {
		printk("TX_OVERRUN device not ready\n");
		printk("RESULT FAIL\n");
		return 1;
	}

	net_if_up(iface);
	k_sleep(K_MSEC(100));

	if (send_frame(dev, 64U) != 0) {
		pass = false;
	}

	if (send_frame(dev, 1514U) != 0) {
		pass = false;
	}

	if (send_frame(dev, 1515U) != -EMSGSIZE) {
		pass = false;
	}

	if (send_frame(dev, 2000U) != -EMSGSIZE) {
		pass = false;
	}

	printk("RESULT %s\n", pass ? "PASS" : "FAIL");

	return pass ? 0 : 1;
}
```
